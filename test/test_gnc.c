/**
 * @file test_gnc.c
 *
 * Build:
 *   PlatformIO: pio run -e desktop_test
 *   Or: gcc -Iinclude src/fcs/guidance.c src/fcs/autopilot.c test/test_gnc.c -lm -o test_gnc
 *
 * Test items:
 *   1. math_utils: vec3, quat, interp1
 *   2. gain_table: interpolation accuracy
 *   3. guidance: augmented PP output
 *   4. autopilot: 3-loop cascade + roll + fin mixing
 *   5. fin_to_servo: PWM conversion
 *   6. continuous step execution (drift/divergence check)
 *
 * Each test compares C output against MATLAB reference values.
 * Reference values generated by validate_c_vs_matlab.m.
 */

#include <stdio.h>
#include <stdlib.h>
#include <string.h>
#include <math.h>

#include "gnc_types.h"
#include "gnc_config.h"
#include "math_utils.h"
#include "gain_table.h"
#include "guidance.h"
#include "autopilot.h"

/* ================================================================
 *  Test framework (minimal implementation)
 * ================================================================ */

static int g_tests_run = 0;
static int g_tests_passed = 0;
static int g_tests_failed = 0;

#define ASSERT_NEAR(name, val, expected, tol) do { \
    g_tests_run++; \
    float _v = (val), _e = (expected), _t = (tol); \
    if (fabsf(_v - _e) <= _t) { \
        g_tests_passed++; \
    } else { \
        g_tests_failed++; \
        printf("  FAIL: %s = %.8f, expected %.8f (tol=%.1e)\n", \
               name, _v, _e, _t); \
    } \
} while(0)

#define ASSERT_TRUE(name, cond) do { \
    g_tests_run++; \
    if (cond) { g_tests_passed++; } \
    else { g_tests_failed++; printf("  FAIL: %s\n", name); } \
} while(0)

#define TEST_SECTION(name) printf("\n--- %s ---\n", name)

/* ================================================================
 *  1. MATH UTILS
 * ================================================================ */

static void test_math_utils(void)
{
    TEST_SECTION("math_utils");

    /* vec3 basic ops */
    vec3_t a = {1.0f, 2.0f, 3.0f};
    vec3_t b = {4.0f, 5.0f, 6.0f};

    vec3_t sum = vec3_add(a, b);
    ASSERT_NEAR("add.x", sum.x, 5.0f, 1e-6f);
    ASSERT_NEAR("add.y", sum.y, 7.0f, 1e-6f);
    ASSERT_NEAR("add.z", sum.z, 9.0f, 1e-6f);

    vec3_t diff = vec3_sub(a, b);
    ASSERT_NEAR("sub.x", diff.x, -3.0f, 1e-6f);

    ASSERT_NEAR("dot", vec3_dot(a, b), 32.0f, 1e-6f);

    vec3_t cr = vec3_cross(a, b);
    ASSERT_NEAR("cross.x", cr.x, -3.0f, 1e-6f);
    ASSERT_NEAR("cross.y", cr.y,  6.0f, 1e-6f);
    ASSERT_NEAR("cross.z", cr.z, -3.0f, 1e-6f);

    ASSERT_NEAR("norm", vec3_norm(a), sqrtf(14.0f), 1e-6f);

    vec3_t n = vec3_normalize(a);
    ASSERT_NEAR("normalize norm", vec3_norm(n), 1.0f, 1e-6f);

    /* clamp */
    ASSERT_NEAR("clamp lo", clampf(-5.0f, -1.0f, 1.0f), -1.0f, 1e-6f);
    ASSERT_NEAR("clamp hi", clampf(5.0f, -1.0f, 1.0f), 1.0f, 1e-6f);
    ASSERT_NEAR("clamp mid", clampf(0.5f, -1.0f, 1.0f), 0.5f, 1e-6f);

    /* wrap_pi */
    ASSERT_NEAR("wrap_pi(0)", wrap_pi(0.0f), 0.0f, 1e-6f);
    ASSERT_NEAR("wrap_pi(4)", wrap_pi(4.0f), 4.0f - 2*PI_F, 1e-5f);
    ASSERT_NEAR("wrap_pi(-4)", wrap_pi(-4.0f), -4.0f + 2*PI_F, 1e-5f);

    /* quat normalize */
    quat_t q_raw = {2.0f, 0.0f, 0.0f, 0.0f};
    quat_t q_n = quat_normalize(q_raw);
    ASSERT_NEAR("quat_norm q0", q_n.q0, 1.0f, 1e-6f);

    /* quat -> DCM: identity quaternion -> identity DCM */
    quat_t q_id = {1.0f, 0.0f, 0.0f, 0.0f};
    float R[9];
    quat_to_dcm_bn(q_id, R);
    ASSERT_NEAR("dcm_id R[0]", R[0], 1.0f, 1e-6f);
    ASSERT_NEAR("dcm_id R[4]", R[4], 1.0f, 1e-6f);
    ASSERT_NEAR("dcm_id R[8]", R[8], 1.0f, 1e-6f);
    ASSERT_NEAR("dcm_id R[1]", R[1], 0.0f, 1e-6f);

    /* 90 deg pitch (theta=pi/2): nose points down in NED
     * R_BN rotates NED->Body.
     * Pitch up 90 deg: body x-axis points NED up (0,0,-1)
     * So NED North [1,0,0] -> Body: should be [0,0,+1] (body z) */
    float theta = PI_F / 2.0f;
    quat_t q_pitch90 = {cosf(theta/2), 0.0f, sinf(theta/2), 0.0f};
    quat_to_dcm_bn(q_pitch90, R);
    vec3_t north_ned = {1.0f, 0.0f, 0.0f};
    vec3_t north_body = dcm_bn_mul_vec(R, north_ned);
    ASSERT_NEAR("pitch90 N->body.x", north_body.x, 0.0f, 1e-5f);
    ASSERT_NEAR("pitch90 N->body.z", north_body.z, 1.0f, 1e-5f);

    /* quat -> euler round-trip */
    float phi_out, theta_out, psi_out;
    quat_t q_test = {0.9239f, 0.0f, 0.3827f, 0.0f}; /* ~45 deg pitch */
    quat_to_euler_zyx(q_test, &phi_out, &theta_out, &psi_out);
    ASSERT_NEAR("euler theta~45", theta_out, 45.0f * DEG2RAD_F, 1e-3f);
    ASSERT_NEAR("euler phi~0", phi_out, 0.0f, 1e-3f);
    ASSERT_NEAR("euler psi~0", psi_out, 0.0f, 1e-3f);

    printf("  math_utils: done\n");
}

/* ================================================================
 *  2. INTERP1 / GAIN TABLE
 * ================================================================ */

static void test_gain_table(void)
{
    TEST_SECTION("gain_table");

    /* Simple interp1 test */
    float bp[] = {40.0f, 60.0f, 80.0f, 100.0f, 120.0f};
    float tb[] = {1.0f, 2.0f, 3.0f, 4.0f, 5.0f};

    ASSERT_NEAR("interp below", interp1_linear(bp, tb, 5, 30.0f), 1.0f, 1e-6f);
    ASSERT_NEAR("interp above", interp1_linear(bp, tb, 5, 130.0f), 5.0f, 1e-6f);
    ASSERT_NEAR("interp exact", interp1_linear(bp, tb, 5, 80.0f), 3.0f, 1e-6f);
    ASSERT_NEAR("interp mid",   interp1_linear(bp, tb, 5, 70.0f), 2.5f, 1e-6f);
    ASSERT_NEAR("interp 50",    interp1_linear(bp, tb, 5, 50.0f), 1.5f, 1e-6f);

    /* Gain table lookup (all zeros in placeholder ? test structure) */
    gain_table_t gt = {0};
    gt.n_pts = 3;
    gt.V_bp[0] = 40; gt.V_bp[1] = 80; gt.V_bp[2] = 120;
    gt.KR[0] = 0.1f; gt.KR[1] = 0.2f; gt.KR[2] = 0.3f;
    gt.KA[0] = 1.0f; gt.KA[1] = 2.0f; gt.KA[2] = 3.0f;
    gt.KDC[0] = 10.0f; gt.KDC[1] = 20.0f; gt.KDC[2] = 30.0f;
    gt.K_phi[0] = 5.0f; gt.K_phi[1] = 10.0f; gt.K_phi[2] = 15.0f;
    gt.Kp_roll[0] = 0.5f; gt.Kp_roll[1] = 1.0f; gt.Kp_roll[2] = 1.5f;
    gt.Ki_roll[0] = 0.05f; gt.Ki_roll[1] = 0.1f; gt.Ki_roll[2] = 0.15f;

    gains_interp_t g60 = gain_table_lookup(&gt, 60.0f);
    ASSERT_NEAR("gt KR@60", g60.KR, 0.15f, 1e-6f);
    ASSERT_NEAR("gt KA@60", g60.KA, 1.5f, 1e-6f);
    ASSERT_NEAR("gt KDC@60", g60.KDC, 15.0f, 1e-6f);

    gains_interp_t g40 = gain_table_lookup(&gt, 40.0f);
    ASSERT_NEAR("gt KR@40", g40.KR, 0.1f, 1e-6f);

    gains_interp_t g120 = gain_table_lookup(&gt, 120.0f);
    ASSERT_NEAR("gt KR@120", g120.KR, 0.3f, 1e-6f);

    printf("  gain_table: done\n");
}

/* ================================================================
 *  2b. INTERP2 BILINEAR
 * ================================================================ */

static void test_interp2(void)
{
    TEST_SECTION("interp2_bilinear");

    /* Config-independent test: fixed 3x3 table with known values.
     * This tests the interp2_bilinear function itself, not the aero data. */
    float x_bp[3] = {0.0f, 1.0f, 2.0f};
    float y_bp[3] = {10.0f, 20.0f, 30.0f};
    /* z[ix*ny + iy], row-major:
     *        y=10  y=20  y=30
     * x=0:   1.0   2.0   4.0
     * x=1:   3.0   5.0   7.0
     * x=2:   6.0   8.0  10.0  */
    float z[9] = {1.0f, 2.0f, 4.0f,
                  3.0f, 5.0f, 7.0f,
                  6.0f, 8.0f, 10.0f};

    /* Grid point exact */
    ASSERT_NEAR("interp2 (0,10)", interp2_bilinear(x_bp,3, y_bp,3, z, 0.0f, 10.0f), 1.0f, 1e-6f);
    ASSERT_NEAR("interp2 (1,20)", interp2_bilinear(x_bp,3, y_bp,3, z, 1.0f, 20.0f), 5.0f, 1e-6f);
    ASSERT_NEAR("interp2 (2,30)", interp2_bilinear(x_bp,3, y_bp,3, z, 2.0f, 30.0f), 10.0f, 1e-6f);

    /* Mid-cell: x=0.5, y=15 -> tx=0.5, ty=0.5
     * = 0.25*(1+3+2+5) = 2.75 */
    ASSERT_NEAR("interp2 mid", interp2_bilinear(x_bp,3, y_bp,3, z, 0.5f, 15.0f), 2.75f, 1e-5f);

    /* Edge interpolation: x=1.5, y=10 -> tx=0.5, ty=0
     * = 0.5*3 + 0.5*6 = 4.5 */
    ASSERT_NEAR("interp2 edge", interp2_bilinear(x_bp,3, y_bp,3, z, 1.5f, 10.0f), 4.5f, 1e-5f);

    /* Clamp low: x=-1 -> x=0, y=5 -> y=10 => z(0,10) = 1.0 */
    ASSERT_NEAR("interp2 clamp low", interp2_bilinear(x_bp,3, y_bp,3, z, -1.0f, 5.0f), 1.0f, 1e-6f);

    /* Clamp high: x=5 -> x=2, y=50 -> y=30 => z(2,30) = 10.0 */
    ASSERT_NEAR("interp2 clamp high", interp2_bilinear(x_bp,3, y_bp,3, z, 5.0f, 50.0f), 10.0f, 1e-6f);

    /* Also verify with actual aero table if present */
    gnc_config_t cfg = gnc_config_default();
    if (cfg.aero_n_alpha > 0) {
        /* Grid point: CNa(alpha=0, Mach=0.1) from aero table */
        float cna00 = interp2_bilinear(cfg.aero_alpha_bp, cfg.aero_n_alpha,
                                       cfg.aero_mach_bp,  cfg.aero_n_mach,
                                       cfg.CNa_2d, 0.0f, 0.1f);
        ASSERT_NEAR("aero2d CNa(0,0.1)", cna00, cfg.CNa_2d[0], 1e-5f);
        printf("  aero 2D table: CNa(0,0.1)=%.6f\n", cna00);
    }

    /* Legacy Clda table: grid point (0, first Mach) */
    if (cfg.clda_n_alpha > 0) {
        float cl00 = interp2_bilinear(cfg.clda_alpha_bp, cfg.clda_n_alpha,
                                      cfg.clda_mach_bp,  cfg.clda_n_mach,
                                      cfg.clda_2d, 0.0f, cfg.clda_mach_bp[0]);
        ASSERT_NEAR("legacy Clda(0,M0)", cl00, cfg.clda_2d[0], 1e-5f);
    }

    printf("  interp2_bilinear: done\n");
}

/* ================================================================
 *  3. GUIDANCE
 * ================================================================ */

static void test_guidance(void)
{
    TEST_SECTION("guidance");

    gnc_config_t cfg = gnc_config_default();
    cfg.target_ned = (vec3_t){50.0f, 50.0f, -400.0f};

    guid_state_t gs;
    guidance_init(&gs);
    ASSERT_TRUE("guid init", gs.initialized);

    /* Case 1: before t_guide_on -> should return 0 */
    nav_state_t nav = {0};
    nav.pos_ned = (vec3_t){0, 0, -100};
    nav.vel_ned = (vec3_t){10, 10, -50};
    nav.quat = (quat_t){1, 0, 0, 0};
    nav.airspeed = 52.0f;
    nav.valid = true;

    guid_output_t out = guidance_step(&nav, &cfg, &gs, 0.5f);
    ASSERT_NEAR("pre-guid nz", out.nz_cmd, 0.0f, 1e-6f);
    ASSERT_NEAR("pre-guid ny", out.ny_cmd, 0.0f, 1e-6f);
    ASSERT_TRUE("pre-guid inactive", !out.active);

    /* Case 2: active guidance, approaching target
     * Quat aligned with velocity direction to keep alpha small.
     * Airspeed high enough for qbar > qbar_min_ctrl at any config. */
    nav.pos_ned = (vec3_t){10, 10, -200};
    nav.vel_ned = (vec3_t){15, 15, -80};
    nav.airspeed = sqrtf(15*15 + 15*15 + 80*80);  /* ~83 m/s -> qbar > 4000 Pa */
    float theta_g = -atan2f(-nav.vel_ned.z, sqrtf(nav.vel_ned.x*nav.vel_ned.x + nav.vel_ned.y*nav.vel_ned.y));
    float psi_g = atan2f(nav.vel_ned.y, nav.vel_ned.x);
    nav.quat = (quat_t){
        cosf(theta_g/2)*cosf(psi_g/2),
        0,
        sinf(theta_g/2)*cosf(psi_g/2),
        cosf(theta_g/2)*sinf(psi_g/2)
    };  /* approximate ZYX euler -> quat */
    float R_bn[9];
    quat_to_dcm_bn(nav.quat, R_bn);

    out = guidance_step(&nav, &cfg, &gs, 5.0f);
    ASSERT_TRUE("guid active", out.active);
    ASSERT_TRUE("guid range>0", out.range_to_tgt > 0);
    ASSERT_TRUE("guid not past CPA", !out.past_cpa);
    /* nz_cmd should be nonzero (trying to steer toward target) */
    ASSERT_TRUE("guid nz nonzero", fabsf(out.nz_cmd) > 0.001f || fabsf(out.ny_cmd) > 0.001f);

    printf("  nz_cmd=%.4f, ny_cmd=%.4f, range=%.1f, v_close=%.1f\n",
           out.nz_cmd, out.ny_cmd, out.range_to_tgt, out.v_closing);

    /* Case 3: past CPA -> zero guidance (still at high speed) */
    nav.pos_ned = (vec3_t){60, 60, -420};   /* past target */
    nav.vel_ned = (vec3_t){15, 15, -60};    /* moving away, still fast */
    nav.airspeed = sqrtf(15*15 + 15*15 + 60*60);  /* ~64 m/s */

    out = guidance_step(&nav, &cfg, &gs, 10.0f);
    ASSERT_TRUE("past CPA detected", out.past_cpa);
    printf("  Past CPA: nz_cmd=%.4f, ny_cmd=%.4f\n", out.nz_cmd, out.ny_cmd);

    /* Case 4: Wind Drift Lead ? ???? ???? ?? LOS ???? ????
     * wind_est != 0: los_corrected = los_NED - wind_est * t_go
     * -> nz/ny commands should differ from no-wind case
     *
     * NOTE: use conditions that avoid nz_max saturation
     * () */
    {
        guid_state_t gs_nowind, gs_wind;
        guidance_init(&gs_nowind);
        guidance_init(&gs_wind);

        /* High speed (V~100), vel nearly aligned with LOS -> small raw nz */
        nav_state_t nav_w = {0};
        nav_w.pos_ned = (vec3_t){10, 10, -100};
        nav_w.vel_ned = (vec3_t){10, 10, -80};
        nav_w.quat = (quat_t){0.9239f, 0.0f, 0.3827f, 0.0f};  /* ~45 deg pitch */
        nav_w.airspeed = sqrtf(10*10 + 10*10 + 80*80);
        nav_w.valid = true;
        nav_w.wind_est = (vec3_t){0, 0, 0};

        guid_output_t out_nowind = guidance_step(&nav_w, &cfg, &gs_nowind, 5.0f);

        nav_w.wind_est = (vec3_t){5.0f, 3.0f, 0.0f};  /* strong wind */
        guid_output_t out_wind = guidance_step(&nav_w, &cfg, &gs_wind, 5.0f);

        /* Commands should differ with wind compensation */
        float diff_nz = fabsf(out_wind.nz_cmd - out_nowind.nz_cmd);
        float diff_ny = fabsf(out_wind.ny_cmd - out_nowind.ny_cmd);
        ASSERT_TRUE("wind drift changes cmd", diff_nz > 0.001f || diff_ny > 0.001f);
        printf("  Wind Drift Lead: nowind nz=%.4f ny=%.4f, wind nz=%.4f ny=%.4f\n",
               out_nowind.nz_cmd, out_nowind.ny_cmd, out_wind.nz_cmd, out_wind.ny_cmd);
        printf("  Wind Drift Lead: dnz=%.4f, dny=%.4f\n", diff_nz, diff_ny);

        /* wind=0 should match baseline (backward compat) */
        nav_w.wind_est = (vec3_t){0, 0, 0};
        guid_state_t gs_zero;
        guidance_init(&gs_zero);
        guid_output_t out_zero = guidance_step(&nav_w, &cfg, &gs_zero, 5.0f);
        ASSERT_NEAR("wind=0 nz same", out_zero.nz_cmd, out_nowind.nz_cmd, 1e-6f);
        ASSERT_NEAR("wind=0 ny same", out_zero.ny_cmd, out_nowind.ny_cmd, 1e-6f);
    }

    printf("  guidance: done\n");
}

/* ================================================================
 *  4. AUTOPILOT
 * ================================================================ */

static void test_autopilot(void)
{
    TEST_SECTION("autopilot");

    gnc_config_t cfg = gnc_config_default();

    /* Simple gain table setup (verifiable values) */
    cfg.gain_table.n_pts = 1;
    cfg.gain_table.V_bp[0] = 60.0f;
    cfg.gain_table.KR[0] = 0.5f;
    cfg.gain_table.KA[0] = 0.06f;
    cfg.gain_table.KDC[0] = 1.3f;
    cfg.wI = 0.0f;  /* accel integrator frequency (rad/s) */
    cfg.gain_table.K_phi[0] = 7.5f;
    cfg.gain_table.Kp_roll[0] = 2.8f;
    cfg.gain_table.Ki_roll[0] = 8.4f;

    ap_state_t ap;
    autopilot_init(&ap);
    ASSERT_TRUE("ap init", ap.initialized);
    ASSERT_NEAR("ap roll_int init", ap.roll_int, 0.0f, 1e-6f);

    /* Test case: straight flight, small nz command
     * Velocity along body x-axis to keep alpha near 0 */
    nav_state_t nav = {0};
    nav.pos_ned = (vec3_t){0, 0, -200};
    nav.vel_ned = (vec3_t){60, 0, 0};  /* forward flight in NED */
    nav.quat = (quat_t){1, 0, 0, 0};  /* nose North, level */
    nav.omega_b = (vec3_t){0, 0, 0};   /* no rotation */
    nav.airspeed = 60.0f;
    nav.valid = true;

    /* Zero command -> should get zero (or small rate damping) */
    ap_output_t out = autopilot_step(0.0f, 0.0f, &nav, &cfg, &ap);

    ASSERT_NEAR("zero cmd fin1", out.fin_cmd[0], 0.0f, 0.01f);
    ASSERT_NEAR("zero cmd fin2", out.fin_cmd[1], 0.0f, 0.01f);
    ASSERT_NEAR("zero cmd fin3", out.fin_cmd[2], 0.0f, 0.01f);
    ASSERT_NEAR("zero cmd fin4", out.fin_cmd[3], 0.0f, 0.01f);

    /* Nonzero nz_cmd -> should produce pitch deflection */
    out = autopilot_step(2.0f, 0.0f, &nav, &cfg, &ap);
    float de = (out.fin_cmd[0] - out.fin_cmd[2]) / 2.0f;
    ASSERT_TRUE("nz_cmd->de nonzero", fabsf(de) > 0.001f);
    printf("  nz_cmd=2: de=%.4f rad (%.1f deg)\n", de, de * RAD2DEG_F);

    /* Fin saturation test */
    out = autopilot_step(100.0f, 0.0f, &nav, &cfg, &ap);
    for (int i = 0; i < 4; i++) {
        ASSERT_TRUE("fin within limits",
                    out.fin_cmd[i] >= -DELTA_MAX_RAD - 0.001f &&
                    out.fin_cmd[i] <= DELTA_MAX_RAD + 0.001f);
    }
    printf("  saturation test: fins clamped to +/-%.1f deg\n", DELTA_MAX_RAD * RAD2DEG_F);

    /* Fin mixing: roll priority test */
    /* With nonzero p_cmd + nz_cmd -> roll should get priority */
    nav.omega_b = (vec3_t){0, 0, 0};
    /* Simulate roll error: phi != 0, velocity still forward */
    float phi_test = 10.0f * DEG2RAD_F;
    nav.vel_ned = (vec3_t){60, 0, 0};  /* forward flight */
    nav.quat = (quat_t){cosf(phi_test/2), sinf(phi_test/2), 0, 0};

    ap_state_t ap2;
    autopilot_init(&ap2);
    out = autopilot_step(1.0f, 0.0f, &nav, &cfg, &ap2);

    float da = (out.fin_cmd[0] + out.fin_cmd[1] + out.fin_cmd[2] + out.fin_cmd[3]) / 4.0f;
    ASSERT_TRUE("roll present", fabsf(da) > 0.001f);
    printf("  roll priority: da=%.4f rad (%.1f deg), de=%.4f, dr=%.4f\n",
           da, da * RAD2DEG_F, out.de_cmd * RAD2DEG_F, out.dr_cmd * RAD2DEG_F);

    /* Anti-windup: integrator should not blow up */
    ap_state_t ap3;
    autopilot_init(&ap3);
    for (int k = 0; k < 1000; k++) {
        autopilot_step(100.0f, 0.0f, &nav, &cfg, &ap3);
    }
    ASSERT_TRUE("roll_int bounded", fabsf(ap3.roll_int) < 100.0f);
    ASSERT_TRUE("pitch_int bounded", fabsf(ap3.pitch_int) < 100.0f);
    printf("  anti-windup: roll_int=%.4f, pitch_int=%.4f (1000 saturated steps)\n",
           ap3.roll_int, ap3.pitch_int);

    /* Roll alloc limit test: da should be bounded by roll_alloc_max */
    {
        ap_state_t ap4;
        autopilot_init(&ap4);

        nav_state_t nav_r = {0};
        nav_r.pos_ned = (vec3_t){0, 0, -200};
        nav_r.vel_ned = (vec3_t){60, 0, 0};  /* forward flight */
        float big_phi = 30.0f * DEG2RAD_F;
        nav_r.quat = (quat_t){cosf(big_phi/2), sinf(big_phi/2), 0, 0};
        nav_r.omega_b = (vec3_t){0, 0, 0};
        nav_r.airspeed = 60.0f;
        nav_r.valid = true;

        ap_output_t out_r = autopilot_step(2.0f, 0.0f, &nav_r, &cfg, &ap4);
        float da_r = (out_r.fin_cmd[0] + out_r.fin_cmd[1] +
                       out_r.fin_cmd[2] + out_r.fin_cmd[3]) / 4.0f;
        ASSERT_TRUE("roll_alloc limited",
                    fabsf(da_r) <= cfg.roll_alloc_max + 0.001f);
        printf("  roll_alloc_max test: da=%.4f rad (%.1f deg), limit=%.1f deg\n",
               da_r, da_r * RAD2DEG_F, cfg.roll_alloc_max * RAD2DEG_F);
    }

    printf("  autopilot: done\n");
}

/* ================================================================
 *  5. SERVO PWM
 * ================================================================ */

static void test_servo_pwm(void)
{
    TEST_SECTION("servo_pwm");

    float delta_max = DELTA_MAX_RAD;

    /* Center -> 1500 us */
    float fin_zero[4] = {0, 0, 0, 0};
    /* Manual calculation */
    for (int i = 0; i < 4; i++) {
        float normalized = fin_zero[i] / delta_max;
        float half_range = (float)(SERVO_PWM_MAX_US - SERVO_PWM_MIN_US) * 0.5f;
        uint16_t pulse = (uint16_t)((float)SERVO_PWM_CENTER_US + normalized * half_range);
        ASSERT_NEAR("zero->center", (float)pulse, (float)SERVO_PWM_CENTER_US, 1.0f);
    }

    /* +delta_max -> PWM_MAX */
    float fin_max[4] = {delta_max, delta_max, delta_max, delta_max};
    for (int i = 0; i < 4; i++) {
        float normalized = clampf(fin_max[i] / delta_max, -1.0f, 1.0f);
        float half_range = (float)(SERVO_PWM_MAX_US - SERVO_PWM_MIN_US) * 0.5f;
        uint16_t pulse = (uint16_t)((float)SERVO_PWM_CENTER_US + normalized * half_range);
        ASSERT_NEAR("+max->PWM_MAX", (float)pulse, (float)SERVO_PWM_MAX_US, 1.0f);
    }

    /* -delta_max -> PWM_MIN */
    float fin_min[4] = {-delta_max, -delta_max, -delta_max, -delta_max};
    for (int i = 0; i < 4; i++) {
        float normalized = clampf(fin_min[i] / delta_max, -1.0f, 1.0f);
        float half_range = (float)(SERVO_PWM_MAX_US - SERVO_PWM_MIN_US) * 0.5f;
        uint16_t pulse = (uint16_t)((float)SERVO_PWM_CENTER_US + normalized * half_range);
        ASSERT_NEAR("-max->PWM_MIN", (float)pulse, (float)SERVO_PWM_MIN_US, 1.0f);
    }

    printf("  servo_pwm: done\n");
}

/* ================================================================
 *  6. continuous step execution (drift/divergence check)
 * ================================================================ */

static void test_continuous_steps(void)
{
    TEST_SECTION("continuous_steps (100 steps, wI=1.0)");

    gnc_config_t cfg = gnc_config_default();
    cfg.gain_table.n_pts = 1;
    cfg.gain_table.V_bp[0] = 85.0f;
    cfg.gain_table.KR[0]  = 0.169725f;
    cfg.gain_table.KA[0]  = 0.054958f;
    cfg.gain_table.KDC[0] = 1.000000f;
    cfg.wI = 1.0f;
    cfg.gain_table.K_phi[0]   = 1.9359f;
    cfg.gain_table.Kp_roll[0] = 0.1180f;
    cfg.gain_table.Ki_roll[0] = 0.3540f;

    guid_state_t gs;
    guidance_init(&gs);
    ap_state_t ap;
    autopilot_init(&ap);

    nav_state_t nav = {0};
    nav.pos_ned = (vec3_t){0, 0, -100};
    nav.vel_ned = (vec3_t){20, 20, -80};
    /* Align quat with velocity direction -> small alpha */
    float th_cs = -atan2f(80.0f, sqrtf(20.0f*20.0f + 20.0f*20.0f));
    float ps_cs = atan2f(20.0f, 20.0f);
    nav.quat = (quat_t){
        cosf(th_cs/2)*cosf(ps_cs/2), 0,
        sinf(th_cs/2)*cosf(ps_cs/2), cosf(th_cs/2)*sinf(ps_cs/2)
    };
    nav.omega_b = (vec3_t){0.02f, 0.1f, -0.05f};  /* small rate input */
    nav.airspeed = sqrtf(20*20 + 20*20 + 80*80);   /* ~85 m/s -> qbar > 4000 */
    nav.valid = true;

    float t = 2.0f;  /* after t_guide_on */
    int nan_count = 0;
    int sat_count = 0;

    for (int k = 0; k < 100; k++) {
        guid_output_t gout = guidance_step(&nav, &cfg, &gs, t);
        ap_output_t aout = autopilot_step(gout.nz_cmd, gout.ny_cmd, &nav, &cfg, &ap);

        /* NaN check */
        if (isnan(gout.nz_cmd) || isnan(gout.ny_cmd)) nan_count++;
        for (int i = 0; i < 4; i++) {
            if (isnan(aout.fin_cmd[i])) nan_count++;
            if (fabsf(aout.fin_cmd[i]) >= DELTA_MAX_RAD - 0.001f) sat_count++;
        }

        t += GNC_TS;

        /* Slowly move position (very crude ? just to vary inputs) */
        nav.pos_ned.x += nav.vel_ned.x * GNC_TS;
        nav.pos_ned.y += nav.vel_ned.y * GNC_TS;
        nav.pos_ned.z += nav.vel_ned.z * GNC_TS;
    }

    ASSERT_NEAR("no NaN", (float)nan_count, 0.0f, 0.5f);
    ASSERT_TRUE("integrators bounded",
                fabsf(ap.roll_int) < 1000.0f &&
                fabsf(ap.pitch_int) < 1000.0f &&
                fabsf(ap.yaw_int) < 1000.0f);
    /* wI=1.0 and rate!=0, integrator should accumulate */
    ASSERT_TRUE("pitch_int nonzero (wI=1.0)",
                fabsf(ap.pitch_int) > 1e-8f || fabsf(ap.yaw_int) > 1e-8f);

    printf("  100 steps: NaN=%d, saturated_fins=%d\n", nan_count, sat_count);
    printf("  integrators: roll=%.4f, pitch=%.4f, yaw=%.4f\n",
           ap.roll_int, ap.pitch_int, ap.yaw_int);
    printf("  continuous_steps: done\n");
}

/* ================================================================
 *  7. wI integrator test (wI > 0)
 * ================================================================ */

static void test_accel_integrator(void)
{
    TEST_SECTION("accel_integrator (wI=1.0)");

    gnc_config_t cfg = gnc_config_default();
    cfg.gain_table.n_pts = 1;
    cfg.gain_table.V_bp[0] = 100.0f;
    cfg.gain_table.KR[0]  = 0.969315f;
    cfg.gain_table.KA[0]  = 0.113070f;
    cfg.gain_table.KDC[0] = 1.000000f;
    cfg.wI = 1.0f;
    cfg.gain_table.K_phi[0]   = 10.955765f;
    cfg.gain_table.Kp_roll[0] = 0.972802f;
    cfg.gain_table.Ki_roll[0] = 1.945604f;

    ap_state_t ap;
    autopilot_init(&ap);

    nav_state_t nav = {0};
    nav.pos_ned  = (vec3_t){0, 0, -200};
    nav.vel_ned  = (vec3_t){90, 0, -44};
    nav.quat     = (quat_t){1, 0, 0, 0};
    nav.omega_b  = (vec3_t){0, 0.1f, -0.05f};
    nav.airspeed = 100.0f;
    nav.valid    = true;

    /* Step 1: command input -> verify integrator operation */
    float nz_cmd = 0.5f, ny_cmd = -0.2f;
    ap_output_t out1 = autopilot_step(nz_cmd, ny_cmd, &nav, &cfg, &ap);

    ASSERT_TRUE("pitch_int nonzero after 1 step", fabsf(ap.pitch_int) > 1e-8f);
    ASSERT_TRUE("yaw_int nonzero after 1 step",   fabsf(ap.yaw_int)   > 1e-8f);
    ASSERT_TRUE("fin1 not NaN", !isnan(out1.fin_cmd[0]));

    printf("  step 1: pitch_int=%.6f, yaw_int=%.6f\n", ap.pitch_int, ap.yaw_int);
    printf("  step 1: de=%.6f, dr=%.6f\n", out1.de_cmd, out1.dr_cmd);

    /* 10 steps: verify integrator accumulation */
    float prev_pitch_int = ap.pitch_int;
    for (int k = 0; k < 10; k++) {
        autopilot_step(nz_cmd, ny_cmd, &nav, &cfg, &ap);
    }
    ASSERT_TRUE("pitch_int grows over 10 steps",
                fabsf(ap.pitch_int) > fabsf(prev_pitch_int));

    printf("  step 11: pitch_int=%.6f, yaw_int=%.6f\n", ap.pitch_int, ap.yaw_int);

    /* Anti-windup: ?? ???? -> saturation -> ?????? ???? */
    ap_state_t ap2;
    autopilot_init(&ap2);
    float nz_big = 10.0f;
    for (int k = 0; k < 200; k++) {
        autopilot_step(nz_big, 0.0f, &nav, &cfg, &ap2);
    }
    ASSERT_TRUE("pitch_int bounded by anti-windup",
                fabsf(ap2.pitch_int) < 100.0f);

    printf("  anti-windup: pitch_int=%.4f after 200 saturated steps\n", ap2.pitch_int);

    /* wI=0 comparison: verify integrator disabled */
    cfg.wI = 0.0f;
    ap_state_t ap3;
    autopilot_init(&ap3);
    autopilot_step(nz_cmd, ny_cmd, &nav, &cfg, &ap3);
    ASSERT_NEAR("wI=0: pitch_int stays zero", ap3.pitch_int, 0.0f, 1e-10f);
    ASSERT_NEAR("wI=0: yaw_int stays zero",   ap3.yaw_int,   0.0f, 1e-10f);
}

/* ================================================================
 *  8. C-MATLAB validation data export
 *
 *  Usage:
 *    1) gcc -o test_gnc test_gnc.c autopilot.c guidance.c gnc_main.c -lm -I.
 *    2) ./test_gnc              -> c_validation.json generated
 *    3) In MATLAB: validate_c_vs_matlab  -> auto-compare
 * ================================================================ */

static void export_validation_data(void)
{
    TEST_SECTION("C-MATLAB validation");

    FILE *fp = fopen("../matlab/c_validation.json", "w");
    if (!fp) { printf("  Failed to create c_validation.json\n"); return; }

    fprintf(fp, "{\n");

    /* ---- Part A: Autopilot only (default gain table, lookup at V=100) ---- */
    {
        /* Uses gnc_config_default() gain table directly.
         * MATLAB side uses interp1(par.gain_table, V=100) from same source.
         * No hardcoded gains — both sides derive from rocket_params.m. */
        gnc_config_t cfg = gnc_config_default();
        cfg.Ts = 0.01f;
        /* wI from config (should be ACCEL_WI = par.wI_accel) */

        ap_state_t ap;
        autopilot_init(&ap);

        nav_state_t nav = {0};
        nav.pos_ned  = (vec3_t){0, 0, -200};
        nav.vel_ned  = (vec3_t){100, 0, 0};
        nav.quat     = (quat_t){1, 0, 0, 0};
        nav.omega_b  = (vec3_t){0, 0.1f, -0.05f};
        nav.airspeed = 100.0f;
        nav.valid = true;

        ap_output_t aout = autopilot_step(0.5f, -0.2f, &nav, &cfg, &ap);

        fprintf(fp, "  \"partA\": {\n");
        fprintf(fp, "    \"wI\": %.12e,\n", cfg.wI);
        fprintf(fp, "    \"de_cmd\": %.12e,\n", aout.de_cmd);
        fprintf(fp, "    \"dr_cmd\": %.12e,\n", aout.dr_cmd);
        fprintf(fp, "    \"pitch_int\": %.12e,\n", ap.pitch_int);
        fprintf(fp, "    \"yaw_int\": %.12e\n", ap.yaw_int);
        fprintf(fp, "  },\n");

        printf("  Part A written: de=%.10f dr=%.10f\n", aout.de_cmd, aout.dr_cmd);
    }

    /* ---- Part B: Guidance + Autopilot (full gain table from config.h) ---- */
    {
        gnc_config_t cfg = gnc_config_default();
        cfg.Ts = 0.01f;

        guid_state_t gs;
        guidance_init(&gs);
        ap_state_t ap;
        autopilot_init(&ap);

        nav_state_t nav = {0};
        nav.pos_ned  = (vec3_t){20.0f, 15.0f, -250.0f};
        nav.vel_ned  = (vec3_t){70.0f, 10.0f, -40.0f};
        nav.quat     = (quat_t){0.9659f, 0.0f, 0.2588f, 0.0f};  /* ~30 deg pitch up */
        nav.omega_b  = (vec3_t){0.01f, 0.5f, -0.1f};
        nav.airspeed = sqrtf(70*70 + 10*10 + 40*40);
        nav.valid = true;

        float t = 5.0f;

        guid_output_t gout = guidance_step(&nav, &cfg, &gs, t);
        ap_output_t aout = autopilot_step(gout.nz_cmd, gout.ny_cmd, &nav, &cfg, &ap);

        /* Part B debug: intermediate autopilot values */
        printf("  [DBG B] de=%.6f dr=%.6f da=%.6f\n",
               aout.de_cmd, aout.dr_cmd, aout.da_cmd);

        fprintf(fp, "  \"partB\": {\n");
        fprintf(fp, "    \"nz_cmd\": %.12e,\n", gout.nz_cmd);
        fprintf(fp, "    \"ny_cmd\": %.12e,\n", gout.ny_cmd);
        fprintf(fp, "    \"de_cmd\": %.12e,\n", aout.de_cmd);
        fprintf(fp, "    \"dr_cmd\": %.12e,\n", aout.dr_cmd);
        fprintf(fp, "    \"da_cmd\": %.12e,\n", aout.da_cmd);
        fprintf(fp, "    \"fin_cmd\": [%.12e, %.12e, %.12e, %.12e]\n",
                aout.fin_cmd[0], aout.fin_cmd[1], aout.fin_cmd[2], aout.fin_cmd[3]);
        fprintf(fp, "  }\n");

        printf("  Part B written: nz=%.8f ny=%.8f de=%.8f\n",
               gout.nz_cmd, gout.ny_cmd, aout.de_cmd);
    }

    fprintf(fp, "}\n");
    fclose(fp);
    printf("  c_validation.json saved\n");
}

/* ================================================================
 *  9. Roll control changes validation
 *     - phi_grav = atan2(R_BN[5], R_BN[8]) vs old e_roll
 *     - Integrator reset on Mach guard
 *     - Gain ramp-in after Mach guard release
 *
 *  ADD THIS FUNCTION to test_gnc.c and call from main().
 * ================================================================ */
 
static void test_roll_phi_grav(void)
{
    TEST_SECTION("roll_phi_grav (gravity-referenced roll angle)");
 
    /* ---- Test 9a: phi_grav accuracy at various pitch angles ---- */
    /* phi_grav = atan2(R_BN[5], R_BN[8]) should return exact euler phi
     * regardless of pitch angle (cos(theta) cancels in the ratio). */
    {
        typedef struct { float phi_deg; float theta_deg; } test_case_t;
        test_case_t cases[] = {
            { 0.0f,  0.0f},
            {10.0f,  0.0f},
            {10.0f, 45.0f},
            {10.0f, 70.0f},
            {10.0f, 85.0f},
            {-5.0f, 70.0f},
            {30.0f, 60.0f},
        };
        int n_cases = sizeof(cases) / sizeof(cases[0]);
 
        for (int i = 0; i < n_cases; i++) {
            float phi = cases[i].phi_deg * DEG2RAD_F;
            float theta = cases[i].theta_deg * DEG2RAD_F;
 
            /* Build quaternion from euler ZYX (psi=0) */
            float cp = cosf(phi/2), sp = sinf(phi/2);
            float ct = cosf(theta/2), st = sinf(theta/2);
            quat_t q;
            q.q0 = cp*ct;  q.q1 = sp*ct;
            q.q2 = cp*st;  q.q3 = -sp*st;
            q = quat_normalize(q);
 
            float R[9];
            quat_to_dcm_bn(q, R);
 
            float phi_grav = atan2f(R[5], R[8]);
            float old_e_roll = 2.0f*(q.q0*q.q1 + q.q2*q.q3);
 
            char name[64];
            snprintf(name, sizeof(name),
                     "phi_grav phi=%.0f theta=%.0f", cases[i].phi_deg, cases[i].theta_deg);
            ASSERT_NEAR(name, phi_grav, phi, 1e-5f);
 
            /* Print comparison with old method */
            if (i == 3) { /* theta=70 case */
                printf("  theta=70: phi_grav=%.6f rad, old e_roll=%.6f rad, true=%.6f rad\n",
                       phi_grav, old_e_roll, phi);
                printf("  theta=70: old method = %.1f%% of true phi (cos(70) attenuation)\n",
                       (old_e_roll / phi) * 100.0f);
            }
        }
    }
 
    /* ---- Test 9b: R_BN indexing consistency ---- */
    /* Verify R_BN[5] = 2*(q2*q3 + q0*q1) and R_BN[8] = 1-2*(q1^2+q2^2) */
    {
        float phi = 10.0f * DEG2RAD_F;
        float theta = 70.0f * DEG2RAD_F;
        float cp = cosf(phi/2), sp = sinf(phi/2);
        float ct = cosf(theta/2), st = sinf(theta/2);
        quat_t q;
        q.q0 = cp*ct;  q.q1 = sp*ct;
        q.q2 = cp*st;  q.q3 = -sp*st;
        q = quat_normalize(q);
 
        float R[9];
        quat_to_dcm_bn(q, R);
 
        /* Manual calculation */
        float R5_manual = 2.0f*(q.q2*q.q3 + q.q0*q.q1);
        float R8_manual = 1.0f - 2.0f*(q.q1*q.q1 + q.q2*q.q2);
 
        ASSERT_NEAR("R_BN[5] index", R[5], R5_manual, 1e-6f);
        ASSERT_NEAR("R_BN[8] index", R[8], R8_manual, 1e-6f);
    }
 
    /* ---- Test 9c: Mach guard integrator reset ---- */
    {
        gnc_config_t cfg = gnc_config_default();
        cfg.roll_mode = CTRL_FULL;
        cfg.pitch_yaw_mode = CTRL_OFF;
 
        ap_state_t ap;
        autopilot_init(&ap);
 
        /* Low Mach: roll active, accumulate integrator */
        nav_state_t nav = {0};
        nav.pos_ned  = (vec3_t){0, 0, -200};
        nav.vel_ned  = (vec3_t){100, 0, 0};
        nav.airspeed = 100.0f;  /* Mach = 0.29 < 0.38 */
        nav.valid = true;
 
        /* 5 deg roll to generate error */
        float phi = 5.0f * DEG2RAD_F;
        float theta = 70.0f * DEG2RAD_F;
        float cp = cosf(phi/2), sp = sinf(phi/2);
        float ct = cosf(theta/2), st = sinf(theta/2);
        nav.quat.q0 = cp*ct;  nav.quat.q1 = sp*ct;
        nav.quat.q2 = cp*st;  nav.quat.q3 = -sp*st;
        nav.quat = quat_normalize(nav.quat);
        nav.omega_b = (vec3_t){0.1f, 0, 0};
 
        for (int k = 0; k < 10; k++) {
            autopilot_step(0.0f, 0.0f, &nav, &cfg, &ap);
        }
        ASSERT_TRUE("roll_int nonzero before guard", fabsf(ap.roll_int) > 1e-6f);
        printf("  Before Mach guard: roll_int=%.6f, roll_ramp=%.4f\n",
               ap.roll_int, ap.roll_ramp);
 
        /* High Mach: Mach guard active -> integrator should reset */
        nav.airspeed = 180.0f;  /* Mach = 0.53 > 0.38 */
        nav.vel_ned = (vec3_t){180, 0, 0};
        autopilot_step(0.0f, 0.0f, &nav, &cfg, &ap);
 
        ASSERT_NEAR("roll_int reset", ap.roll_int, 0.0f, 1e-6f);
        ASSERT_NEAR("roll_e_prev reset", ap.roll_e_prev, 0.0f, 1e-6f);
        ASSERT_NEAR("roll_ramp reset", ap.roll_ramp, 0.0f, 1e-6f);
        printf("  After Mach guard: roll_int=%.6f, roll_ramp=%.4f\n",
               ap.roll_int, ap.roll_ramp);
    }
 
    /* ---- Test 9d: Gain ramp-in after Mach guard release ---- */
    {
        gnc_config_t cfg = gnc_config_default();
        cfg.roll_mode = CTRL_FULL;
        cfg.pitch_yaw_mode = CTRL_OFF;
 
        ap_state_t ap;
        autopilot_init(&ap);
 
        nav_state_t nav = {0};
        nav.pos_ned  = (vec3_t){0, 0, -200};
        nav.valid = true;
        nav.omega_b = (vec3_t){0, 0, 0};
 
        float phi = 10.0f * DEG2RAD_F;
        float theta = 30.0f * DEG2RAD_F;
        float cp = cosf(phi/2), sp = sinf(phi/2);
        float ct = cosf(theta/2), st = sinf(theta/2);
        nav.quat.q0 = cp*ct;  nav.quat.q1 = sp*ct;
        nav.quat.q2 = cp*st;  nav.quat.q3 = -sp*st;
        nav.quat = quat_normalize(nav.quat);
 
        /* Enter Mach guard */
        nav.airspeed = 180.0f;
        nav.vel_ned = (vec3_t){180, 0, 0};
        autopilot_step(0.0f, 0.0f, &nav, &cfg, &ap);
        ASSERT_NEAR("ramp after guard", ap.roll_ramp, 0.0f, 1e-6f);
 
        /* Release Mach guard — ramp should start */
        nav.airspeed = 100.0f;
        nav.vel_ned = (vec3_t){100, 0, 0};
 
        /* Step 1: ramp = Ts */
        ap_output_t out1 = autopilot_step(0.0f, 0.0f, &nav, &cfg, &ap);
        ASSERT_NEAR("ramp step 1", ap.roll_ramp, cfg.Ts, 1e-6f);
        printf("  Ramp step 1: roll_ramp=%.4f, da=%.6f\n",
               ap.roll_ramp, out1.da_cmd);
 
        /* Step 2: ramp = 2*Ts */
        autopilot_step(0.0f, 0.0f, &nav, &cfg, &ap);
        ASSERT_NEAR("ramp step 2", ap.roll_ramp, 2.0f * cfg.Ts, 1e-6f);
 
        /* After 0.5s (200 steps @ 400Hz): ramp should saturate at 0.5 */
        for (int k = 0; k < 250; k++) {
            autopilot_step(0.0f, 0.0f, &nav, &cfg, &ap);
        }
        ASSERT_NEAR("ramp saturated", ap.roll_ramp, 0.5f, 1e-6f);
        printf("  Ramp saturated: roll_ramp=%.4f\n", ap.roll_ramp);
    }
 
    printf("  roll_phi_grav: done\n");
}

/* ================================================================
 *  MAIN
 * ================================================================ */

int main(void)
{
    printf("====== GNC FLIGHT COMPUTER ? UNIT TESTS ======\n");
    printf("Platform: Desktop (no ESP32)\n");
    printf("Float size: %zu bytes\n\n", sizeof(float));

    test_math_utils();
    test_gain_table();
    test_interp2();
    test_guidance();
    test_autopilot();
    test_servo_pwm();
    test_continuous_steps();
    test_accel_integrator();
    test_roll_phi_grav();
    export_validation_data();

    printf("\n====== RESULTS ======\n");
    printf("  Total:  %d\n", g_tests_run);
    printf("  Passed: %d\n", g_tests_passed);
    printf("  Failed: %d\n", g_tests_failed);
    printf("  %s\n", g_tests_failed == 0 ? "ALL PASSED" : "SOME FAILED");
    printf("=================\n");

    return g_tests_failed > 0 ? 1 : 0;
}